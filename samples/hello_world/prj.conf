## prj.conf
```kconfig
# nothing here

#CONFIG_HAS_ALIF_SE_SERVICES=n
#CONFIG_ARM_MHUV2=n



# CONFIG_MULTITHREADING=n
# CONFIG_SYS_CLOCK_EXISTS=n
# CONFIG_ARM_MPU=n
```

## src/main.c
```c
/*
 * Copyright (c) 2012-2014 Wind River Systems, Inc.
 *
 * SPDX-License-Identifier: Apache-2.0
 */

#include <stdio.h>

int main(void)
{

	printf("\r\n Hello World! %s \r\n", CONFIG_BOARD);
	return 0;
}
```
